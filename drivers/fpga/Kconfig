## drivers/fpga/Kconfig
```kconfig
menu "FPGA support"

config FPGA
	bool

config FPGA_XILINX
	bool "Enable Xilinx FPGA drivers"
	select FPGA
	help
	  Enable Xilinx FPGA specific functions which includes bitstream
	  (in BIT format), fpga and device validation.

config FPGA_ZYNQMPPL
	bool "Enable Xilinx FPGA driver for ZynqMP"
	depends on FPGA_XILINX
	help
	  Enable FPGA driver for loading bitstream in BIT and BIN format
	  on Xilinx Zynq UltraScale+ (ZynqMP) device.

config FPGA_SPARTAN3
	bool "Enable Xilinx Spartan-III driver"
	depends on FPGA_XILINX
	help
	  Enable FPGA driver for Xilinx Spartan-III devices.

config FPGA_SPARTAN2
	bool "Enable Xilinx Spartan-II driver"
	depends on FPGA_XILINX
	help
	  Enable FPGA driver for Xilinx Spartan-II devices.

config FPGA_VIRTEX2
	bool "Enable Xilinx Virtex2 driver"
	depends on FPGA_XILINX
	help
	  Enable FPGA driver for Xilinx Virtex2 devices.

config FPGA_ALTERA
	bool "Enable Altera FPGA drivers"
	select FPGA

config FPGA_ACEX1K
	bool "Enable Altera ACEX1K driver"
	depends on FPGA_ALTERA
	help
	  Enable FPGA driver for Altera ACEX1K devices

config FPGA_CYCLON2
	bool "Enable Altera Cyclone 2 driver"
	depends on FPGA_ALTERA
	help
	  Enable FPGA driver for Altera Cyclone 2 devices

config FPGA_STRATIX_II
	bool "Enable Altera StratixV driver"
	depends on FPGA_ALTERA
	help
	  Enable FPGA driver for Altera Stratix II devices

config FPGA_STRATIX_V
	bool "Enable Altera StratixV driver"
	depends on FPGA_ALTERA
	help
	  Enable FPGA driver for Altera StratixV devices

config FPGA_SOCFPGA
	bool "Enable Altera SoCFPGA driver"
	depends on FPGA_ALTERA
	help
	  Enable FPGA driver for Altera SoCFPGA devices

config FPGA_PROG_FEEDBACK
	bool "FPGA programming feedback"
	depends on FPGA_SPARTAN3 || FPGA_SPARTAN2 || \
		   FPGA_ACEX1K || FPGA_CYCLON2
	help
	  Enable printing of hash marks during FPGA configuration.

endmenu
```
